## archive/gsr_wristband_wifi/main/Kconfig.projbuild
```kconfig
menu "DermEdge wristband"

    config DERMEDGE_WINDOW_SECONDS
        int "Window length (s)"
        default 30
        help
            The stress model was trained on 30 s WESAD windows. Each finished window is POSTed
            to the hub's /api/wearable/window; the hub's first 3 calibrate it to the wearer.

    choice DERMEDGE_GSR_SOURCE
        prompt "Skin conductance (GSR) source"
        default DERMEDGE_GSR_SIMULATED
        config DERMEDGE_GSR_SIMULATED
            bool "Simulated (BOOT button toggles calm / stressed)"
        config DERMEDGE_GSR_GROVE
            bool "Grove GSR module on an ADC pin"
    endchoice

    config DERMEDGE_GSR_ADC_CHANNEL
        int "GSR ADC1 channel (6 = GPIO34)"
        depends on DERMEDGE_GSR_GROVE
        default 6
        range 0 7

    choice DERMEDGE_TEMP_SOURCE
        prompt "Skin temperature source"
        default DERMEDGE_TEMP_SIMULATED
        config DERMEDGE_TEMP_SIMULATED
            bool "Simulated (follows the calm / stressed state)"
        config DERMEDGE_TEMP_LM35
            bool "LM35 on an ADC pin"
            help
                LM35 flat side facing you: left pin (+Vs) to 5V/VIN -- it needs at least 4 V, so
                not 3V3 -- middle pin (Vout) to the ADC pin, right pin to GND. Skin reads ~300-350
                mV, well inside the ESP32's input range even with the sensor on 5V.
        config DERMEDGE_TEMP_NTC
            bool "NTC thermistor in a voltage divider on an ADC pin"
            help
                3V3 -> fixed resistor -> ADC pin -> thermistor -> GND. Warmer skin lowers the
                thermistor's resistance and so the pin voltage (~1.4 V at 33 C with 10k parts).
    endchoice

    config DERMEDGE_TEMP_ADC_CHANNEL
        int "Temperature sensor ADC1 channel (7 = GPIO35)"
        depends on DERMEDGE_TEMP_LM35 || DERMEDGE_TEMP_NTC
        default 7
        range 0 7
        help
            ADC1 only: ADC2 pins stop working while WiFi is on. Must differ from the GSR channel.

    config DERMEDGE_NTC_R25
        int "Thermistor resistance at 25 C (ohms)"
        depends on DERMEDGE_TEMP_NTC
        default 10000
        help
            The number printed on the part or in its listing: "10K NTC" = 10000.

    config DERMEDGE_NTC_BETA
        int "Thermistor B (beta) value"
        depends on DERMEDGE_TEMP_NTC
        default 3950
        help
            From the listing or datasheet, e.g. "B3950" or "B25/50 = 3950". 3950 and 3435 are
            the common ones.

    config DERMEDGE_NTC_SERIES_R
        int "Fixed divider resistor (ohms)"
        depends on DERMEDGE_TEMP_NTC
        default 10000
        help
            The resistor between 3V3 and the ADC pin. Use the same value as the thermistor's
            25 C resistance; measure it with a multimeter for a more accurate reading.

    choice DERMEDGE_MOISTURE_SOURCE
        prompt "Skin moisture patch source"
        default DERMEDGE_MOISTURE_SIMULATED
        config DERMEDGE_MOISTURE_SIMULATED
            bool "Simulated (eczema patch ~6% drier than reference)"
        config DERMEDGE_MOISTURE_TOUCH
            bool "ESP32 touch pins as capacitive electrodes"
            help
                A crude stand-in for the Southampton e-textile sensor: one electrode taped over
                the eczema-prone area (T0 = GPIO4), one over healthy skin (T3 = GPIO15). Wetter
                skin adds capacitance and lowers the touch reading.
        config DERMEDGE_MOISTURE_OFF
            bool "No moisture patch"
    endchoice

    config DERMEDGE_STRESS_BUTTON_GPIO
        int "Calm/stressed toggle button GPIO (simulated GSR)"
        default 0
        help
            GPIO0 is the BOOT button on most ESP32 dev boards.

endmenu
```

## firmware_dermedge/components/dermedge_net/Kconfig
```kconfig
menu "DermEdge network"

    config DERMEDGE_WIFI_SSID
        string "WiFi name (SSID)"
        default "DermEdge"
        help
            The network the laptop hub is on -- e.g. the laptop's own hotspot, so nothing
            touches the internet.

    config DERMEDGE_WIFI_PASSWORD
        string "WiFi password"
        default "changeme123"

    config DERMEDGE_HUB_URL
        string "Hub URL (no trailing slash)"
        default "http://192.168.2.1:8000"
        help
            Where app/server.py runs: http://<laptop IP on that network>:8000. On macOS the IP is in
            System Settings > Wi-Fi > Details; on a macOS hotspot (Internet Sharing) it is
            usually 192.168.2.1.

endmenu
```

## firmware_dermedge/esp32cam_screen/main/Kconfig.projbuild
```kconfig
menu "DermEdge camera"

    choice DERMEDGE_SCREEN_MODE
        prompt "Where the normal-vs-rash screen runs"
        default DERMEDGE_SCREEN_ON_DEVICE
        help
            On device: the 300 KB INT8 model runs here (97% on its own test set, but its
            "normal" training photos were stock images, so it is weak on real skin).
            On hub: every frame goes to the laptop's CLIP rash screen (AUC 0.93 on real phone
            photos) -- more accurate, needs the hub reachable all the time.

        config DERMEDGE_SCREEN_ON_DEVICE
            bool "On device (TFLite Micro)"
        config DERMEDGE_SCREEN_ON_HUB
            bool "On the laptop hub (/api/screen)"
    endchoice

    config DERMEDGE_CAPTURE_PERIOD_MS
        int "Time between captures (ms)"
        default 3000

    config DERMEDGE_POSITIVE_STREAK
        int "Positive frames in a row before sending for full analysis"
        default 2
        help
            Stops one odd frame from triggering the full pipeline.

    config DERMEDGE_COOLDOWN_S
        int "Seconds to wait after a full analysis before the next"
        default 20

    config DERMEDGE_THRESHOLD_PERCENT
        int "Positive threshold (percent)"
        default 50

    config DERMEDGE_SWAP_RB
        bool "Swap red and blue before the model"
        default y
        help
            esp32-camera's fmt2rgb888() writes pixels as B,G,R. The model was trained on R,G,B,
            so the default swaps them back. Untick only if you change the decoder.

    config DERMEDGE_FLASH_DURING_CAPTURE
        bool "Light the white flash LED while capturing"
        default n
        help
            Even lighting helps the model, but the AI-Thinker flash LED is very bright.

endmenu
```

## firmware_dermedge/wristband/main/Kconfig.projbuild
```kconfig
menu "DermEdge wristband"

    config DERMEDGE_WINDOW_SECONDS
        int "Window length (s)"
        default 30
        help
            The stress model was trained on 30 s WESAD windows. Each finished window is POSTed
            to the hub's /api/wearable/window; the hub's first 3 calibrate it to the wearer.

    choice DERMEDGE_GSR_SOURCE
        prompt "Skin conductance (GSR) source"
        default DERMEDGE_GSR_SIMULATED
        config DERMEDGE_GSR_SIMULATED
            bool "Simulated (BOOT button toggles calm / stressed)"
        config DERMEDGE_GSR_GROVE
            bool "Grove GSR module on an ADC pin"
    endchoice

    config DERMEDGE_GSR_ADC_CHANNEL
        int "GSR ADC1 channel (6 = GPIO34)"
        depends on DERMEDGE_GSR_GROVE
        default 6
        range 0 7

    choice DERMEDGE_TEMP_SOURCE
        prompt "Skin temperature source"
        default DERMEDGE_TEMP_SIMULATED
        config DERMEDGE_TEMP_SIMULATED
            bool "Simulated (follows the calm / stressed state)"
        config DERMEDGE_TEMP_LM35
            bool "LM35 on an ADC pin"
            help
                LM35 flat side facing you: left pin (+Vs) to 5V/VIN -- it needs at least 4 V, so
                not 3V3 -- middle pin (Vout) to the ADC pin, right pin to GND. Skin reads ~300-350
                mV, well inside the ESP32's input range even with the sensor on 5V.
    endchoice

    config DERMEDGE_TEMP_ADC_CHANNEL
        int "LM35 ADC1 channel (7 = GPIO35)"
        depends on DERMEDGE_TEMP_LM35
        default 7
        range 0 7
        help
            ADC1 only: ADC2 pins stop working while WiFi is on. Must differ from the GSR channel.

    choice DERMEDGE_MOISTURE_SOURCE
        prompt "Skin moisture patch source"
        default DERMEDGE_MOISTURE_SIMULATED
        config DERMEDGE_MOISTURE_SIMULATED
            bool "Simulated (eczema patch ~6% drier than reference)"
        config DERMEDGE_MOISTURE_TOUCH
            bool "ESP32 touch pins as capacitive electrodes"
            help
                A crude stand-in for the Southampton e-textile sensor: one electrode taped over
                the eczema-prone area (T0 = GPIO4), one over healthy skin (T3 = GPIO15). Wetter
                skin adds capacitance and lowers the touch reading.
        config DERMEDGE_MOISTURE_OFF
            bool "No moisture patch"
    endchoice

    config DERMEDGE_STRESS_BUTTON_GPIO
        int "Calm/stressed toggle button GPIO (simulated GSR)"
        default 0
        help
            GPIO0 is the BOOT button on most ESP32 dev boards.

endmenu
```

## firmware_skincheck/components/skincheck_net/Kconfig
```kconfig
menu "SkinCheck network"

    config SKINCHECK_WIFI_SSID
        string "WiFi name (SSID)"
        default "SkinCheck"
        help
            The network the laptop hub is on -- e.g. the laptop's own hotspot, so nothing
            touches the internet.

    config SKINCHECK_WIFI_PASSWORD
        string "WiFi password"
        default "changeme123"

    config SKINCHECK_HUB_URL
        string "Hub URL (no trailing slash)"
        default "http://192.168.2.1:8000"
        help
            Where app/server.py runs: http://<laptop IP on that network>:8000. On macOS the IP is in
            System Settings > Wi-Fi > Details; on a macOS hotspot (Internet Sharing) it is
            usually 192.168.2.1.

endmenu
```

## firmware_skincheck/esp32cam_screen/main/Kconfig.projbuild
```kconfig
menu "SkinCheck camera"

    choice SKINCHECK_SCREEN_MODE
        prompt "Where the normal-vs-rash screen runs"
        default SKINCHECK_SCREEN_ON_DEVICE
        help
            On device: the 300 KB INT8 model runs here (97% on its own test set, but its
            "normal" training photos were stock images, so it is weak on real skin).
            On hub: every frame goes to the laptop's CLIP rash screen (AUC 0.93 on real phone
            photos) -- more accurate, needs the hub reachable all the time.

        config SKINCHECK_SCREEN_ON_DEVICE
            bool "On device (TFLite Micro)"
        config SKINCHECK_SCREEN_ON_HUB
            bool "On the laptop hub (/api/screen)"
    endchoice

    config SKINCHECK_CAPTURE_PERIOD_MS
        int "Time between captures (ms)"
        default 3000

    config SKINCHECK_POSITIVE_STREAK
        int "Positive frames in a row before sending for full analysis"
        default 2
        help
            Stops one odd frame from triggering the full pipeline.

    config SKINCHECK_COOLDOWN_S
        int "Seconds to wait after a full analysis before the next"
        default 20

    config SKINCHECK_THRESHOLD_PERCENT
        int "Positive threshold (percent)"
        default 50

    config SKINCHECK_SWAP_RB
        bool "Swap red and blue before the model"
        default y
        help
            esp32-camera's fmt2rgb888() writes pixels as B,G,R. The model was trained on R,G,B,
            so the default swaps them back. Untick only if you change the decoder.

    config SKINCHECK_FLASH_DURING_CAPTURE
        bool "Light the white flash LED while capturing"
        default n
        help
            Even lighting helps the model, but the AI-Thinker flash LED is very bright.

endmenu
```

## firmware_skincheck/wristband/main/Kconfig.projbuild
```kconfig
menu "SkinCheck wristband"

    config SKINCHECK_WINDOW_SECONDS
        int "Window length (s)"
        default 30
        help
            The stress model was trained on 30 s WESAD windows. Each finished window is POSTed
            to the hub's /api/wearable/window; the hub's first 3 calibrate it to the wearer.

    choice SKINCHECK_GSR_SOURCE
        prompt "Skin conductance (GSR) source"
        default SKINCHECK_GSR_SIMULATED
        config SKINCHECK_GSR_SIMULATED
            bool "Simulated (BOOT button toggles calm / stressed)"
        config SKINCHECK_GSR_GROVE
            bool "Grove GSR module on an ADC pin"
    endchoice

    config SKINCHECK_GSR_ADC_CHANNEL
        int "GSR ADC1 channel (6 = GPIO34)"
        depends on SKINCHECK_GSR_GROVE
        default 6
        range 0 7

    choice SKINCHECK_MOISTURE_SOURCE
        prompt "Skin moisture patch source"
        default SKINCHECK_MOISTURE_SIMULATED
        config SKINCHECK_MOISTURE_SIMULATED
            bool "Simulated (eczema patch ~6% drier than reference)"
        config SKINCHECK_MOISTURE_TOUCH
            bool "ESP32 touch pins as capacitive electrodes"
            help
                A crude stand-in for the Southampton e-textile sensor: one electrode taped over
                the eczema-prone area (T0 = GPIO4), one over healthy skin (T3 = GPIO15). Wetter
                skin adds capacitance and lowers the touch reading.
        config SKINCHECK_MOISTURE_OFF
            bool "No moisture patch"
    endchoice

    config SKINCHECK_STRESS_BUTTON_GPIO
        int "Calm/stressed toggle button GPIO (simulated GSR)"
        default 0
        help
            GPIO0 is the BOOT button on most ESP32 dev boards.

endmenu
```
